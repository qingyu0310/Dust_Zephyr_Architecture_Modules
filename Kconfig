## Kconfig
```kconfig
# modules/Kconfig - hardware-facing modules built on top of drivers/topics

config DUST_MOD_DEV_IMU
    bool "IMU module"
    default n
    select DUST_FLT_QUATERNION
    select DUST_TPC_IMU_TO
    select DUST_DEV_PWM
    select DUST_CTL_PID
    select DUST_CTL_TIMER
    select DUST_ID_STABILITY
    help
        IMU source decoupling, attitude EKF and zbus publish layer.

config DUST_MOD_DEV_IMU_BMI088
    bool "BMI088 IMU source"
    default n
    depends on DUST_MOD_DEV_IMU
    select DUST_COM_SPI
    help
        BMI088 source implementation for the IMU module.

config DUST_MOD_DEV_IMU_ICM42688P
    bool "ICM42688P IMU source"
    default n
    depends on DUST_MOD_DEV_IMU
    select DUST_COM_SPI
    help
        ICM42688P source implementation for the IMU module.

config DUST_MOD_DEV_IMU_IDENT
    bool "IMU open-loop identification"
    default n
    select DUST_ID_STABILITY
    select DUST_COM_UART_DMA
    help
        IMU heater duty-step open-loop identification.

config DUST_MOD_DEV_MOTOR_DJI
    bool "DJI motor"
    default n
    select DUST_COM_CAN
    help
        DJI motor module.

config DUST_MOD_DEV_MOTOR_DM
    bool "DM motor"
    default n
    select DUST_COM_CAN
    help
        DM motor module.

config DUST_MOD_DEV_POWERMETER
    bool "Horizon power meter"
    default n
    select DUST_COM_CAN
    help
        Horizon power meter module.

config DUST_MOD_DEV_REMOTE
    bool "Remote receiver"
    default n
    select DUST_COM_UART_DMA
    select DUST_TPC_REMOTE_TO
    help
        Remote receiver module.

config DUST_MOD_DEV_REMOTE_DUAL
    bool "Dual remote support"
    default n
    depends on DUST_MOD_DEV_REMOTE
    help
        Enable two independent remote receiver instances.

config DUST_MOD_DEV_REMOTE_AUTO
    bool "Auto link all protocols"
    default n
    depends on DUST_MOD_DEV_REMOTE
    help
        Automatically link all available protocol sources.

config DUST_MOD_DEV_REMOTE_DR16
    bool "DR16 protocol"
    default n
    depends on DUST_MOD_DEV_REMOTE
    help
        DR16 remote protocol.

config DUST_MOD_DEV_REMOTE_SBUS
    bool "SBUS protocol"
    default n
    depends on DUST_MOD_DEV_REMOTE
    help
        SBUS remote protocol.

config DUST_MOD_DEV_REMOTE_VT12
    bool "VT12 protocol"
    default n
    depends on DUST_MOD_DEV_REMOTE
    help
        VT12 remote protocol (mouse + keyboard).

config DUST_MOD_DEV_REMOTE_VT13
    bool "VT13 protocol"
    default n
    depends on DUST_MOD_DEV_REMOTE
    help
        VT13 remote protocol (full-featured).
```
